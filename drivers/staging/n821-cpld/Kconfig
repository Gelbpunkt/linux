## drivers/staging/n821-cpld/Kconfig
```kconfig
# SPDX-License-Identifier: GPL-2.0
config N821_CPLD_I2C
	tristate "N821 CPLD I2C controller"
	depends on CISCO_N821_CPLD && I2C && MFD_SYSCON
	select REGMAP_MMIO
	select MDIO_I2C  # Needed for mdio-i2c-gen
	help
	  TODO

	  To compile this driver as a module, choose M here.  The module
	  will be called n821-cpld-i2c.

config N821_CPLD_GPIO
	tristate "N821 CPLD GPIO controller"
	depends on CISCO_N821_CPLD
	select MFD_SYSCON
	select GPIO_REGMAP
	help
	  TODO

	  To compile this driver as a module, choose M here.  The module
	  will be called n821-cpld-gpio.

config N821_CPLD_FAN
	tristate "N821 CPLD fan sensor"
	depends on CISCO_N821_CPLD
	select MFD_SYSCON
	select GPIO_REGMAP
	help
	  TODO

	  To compile this driver as a module, choose M here.  The module
	  will be called n821-cpld-fan.

config N821_CPLD_PSU
	tristate "N821 CPLD PSU sensor"
	depends on CISCO_N821_CPLD
	select MFD_SYSCON
	select GPIO_REGMAP
	help
	  TODO

	  To compile this driver as a module, choose M here.  The module
	  will be called n821-cpld-psu.
```
