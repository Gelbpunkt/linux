## drivers/input/touchscreen/goodix_driver_gt9886/Kconfig
```kconfig
#
# Goodix touchscreen driver configuration
#
menuconfig TOUCHSCREEN_GOODIX_GTX8
	bool "Goodix GTx8 touchscreen"
	depends on I2C
	help
	  Say Y here if you have a Goodix GTx5xx touchscreen connected
	  to your system.

	  If unsure, say N.
```

## drivers/input/touchscreen/gtx8/Kconfig
```kconfig
#
# Goodix touchscreen driver configuration
#
menuconfig TOUCHSCREEN_GOODIX_GTX8
	tristate "Goodix GTx8 touchscreen"
	depends on I2C
	depends on RUST
	default n
	help
	  Say Y here if you have a Goodix GTx8 touch controller
	  to your system.

	  To compile this as a module, choose M here:
	  the module will be called gtx8rs.

	  If unsure, say N.
```
